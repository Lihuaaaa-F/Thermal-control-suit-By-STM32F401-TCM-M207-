## esp32/components/epaper/Kconfig
```kconfig
menu "E-Paper Display (Waveshare 2.9\" B 三色, UC8151)"

    config EPAPER_TEST_MODE
        int "Test mode: 0=正常app(display_task), 1=S1总线, 2=S3三色条, 3=S2白屏+睡眠唤醒, 4=S4老化N次, 6=S6重启x10"
        default 0
        range 0 6
        help
            工作流门禁测试载体(docs/epaper-workflow.md §4)。

    config EPAPER_SPI_HZ
        int "SPI clock (Hz): 2000000 首屏求稳 / 4500000 S4 验收"
        default 2000000
        range 1000000 4800000

    config EPAPER_AGING_COUNT
        int "TEST_MODE=4 老化循环次数"
        default 10
        range 1 2000

    config EPAPER_SCLK_GPIO
        int "SPI SCLK (CLK) GPIO"
        default 12
        help
            红线避开: GPIO33-37(Octal PSRAM)/26-32(Flash)/19,20(USB)/0,3,45,46(strap)。
            GPIO1-10 预留给 ADC1(未来 NTC 测温),数字外设走 11-21 区。

    config EPAPER_MOSI_GPIO
        int "SPI MOSI (DIN) GPIO"
        default 11

    config EPAPER_CS_GPIO
        int "SPI CS GPIO"
        default 13

    config EPAPER_DC_GPIO
        int "Data/Command (DC) GPIO"
        default 14

    config EPAPER_RST_GPIO
        int "Reset (RST) GPIO"
        default 21

    config EPAPER_BUSY_GPIO
        int "Busy GPIO(输入)"
        default 39

endmenu
```
