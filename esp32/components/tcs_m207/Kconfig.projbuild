## esp32/components/tcs_m207/Kconfig.projbuild
```kconfig
menu "M207 Service (R1b)"

    config TCS_M207_SELFLOOP
        bool "R1b 取证构建：UART 内部回环+应答器注入全路径自测（[M207SL]）"
        default n
        help
          开机自测后追加 ~20s 注入序列（在线/写后读回/重发/NAK/离线/恢复/ack/停写）。
          仅取证构建使用；日常构建保持 n。

    config TCS_M207_RAWLOG
        bool "M207 RX 原始字节逐块日志（COMPUSHLIST 自发现试跑取证用）"
        default n
        help
          每块 RX 以原文打印（[M207R]）。真机 M5-M7 接通后试跑 COMPUSHLIST 时开启。

    config TCS_M207_REALPROBE
        bool "R1b 真机取证：P-2 电平判活+协议探针（SYSMODEL/别名/V-5/COMPUSHLIST/压测）+E-06 60s 录帧"
        default n
        help
          需配合 TCS_M207_RAWLOG=y。M5-M7 接通后的真机清账构建；取证完还原 n。

endmenu
```
